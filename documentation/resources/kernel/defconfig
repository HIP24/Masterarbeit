## resources/kernel/notindefconfig
```kconfig
# Lines only output.txt has:
CONFIG_STM_SOURCE_FTRACE=m
CONFIG_MAC80211_MESSAGE_TRACING=y
CONFIG_TRACING_SUPPORT=y
CONFIG_BOOTTIME_TRACING=y
CONFIG_HWLAT_TRACER=y
CONFIG_TIMERLAT_TRACER=y
CONFIG_WIL6210_TRACING=y
CONFIG_STACKTRACE=y
CONFIG_HYPERVISOR_GUEST=y
CONFIG_TRACE_EVENT_INJECT=y
CONFIG_ARCH_CORRECT_STACKTRACE_ON_KRETPROBE=y
CONFIG_SAMPLE_FTRACE_DIRECT=m
CONFIG_TDX_GUEST_DRIVER=m
CONFIG_KVM_AMD=m
CONFIG_TRACEPOINTS=y
CONFIG_KVM_XEN=y
CONFIG_PTP_1588_CLOCK_KVM=m
CONFIG_KVM_GENERIC_HARDWARE_ENABLING=y
CONFIG_HAVE_FUNCTION_TRACER=y
CONFIG_STACK_TRACER=y
CONFIG_TASKS_TRACE_RCU=y
CONFIG_CC_HAS_SANCOV_TRACE_PC=y
CONFIG_HAVE_DYNAMIC_FTRACE_NO_PATCHABLE=y
CONFIG_HAVE_SAMPLE_FTRACE_DIRECT=y
CONFIG_HAVE_KVM_DIRTY_RING_TSO=y
CONFIG_ATH11K_TRACING=y
CONFIG_HAVE_SYSCALL_TRACEPOINTS=y
CONFIG_SYSCTL_EXCEPTION_TRACE=y
CONFIG_INTEL_TDX_GUEST=y
CONFIG_XEN_PVHVM_GUEST=y
CONFIG_JAILHOUSE_GUEST=y
CONFIG_NETFILTER_XT_TARGET_TRACE=m
CONFIG_HAVE_KVM_DIRTY_RING=y
CONFIG_HAVE_FUNCTION_GRAPH_TRACER=y
CONFIG_KVM_GUEST=y
CONFIG_VBOXGUEST=m
CONFIG_BRCM_TRACING=y
CONFIG_DRM_I915_GVT_KVMGT=m
CONFIG_HAVE_KVM_DIRTY_RING_ACQ_REL=y
CONFIG_BLK_DEV_IO_TRACE=y
CONFIG_CAPI_TRACE=y
CONFIG_TRACER_MAX_TRACE=y
CONFIG_HAVE_DYNAMIC_FTRACE_WITH_REGS=y
CONFIG_KVM=m
CONFIG_HAVE_DYNAMIC_FTRACE=y
CONFIG_HAVE_SAMPLE_FTRACE_DIRECT_MULTI=y
CONFIG_ACRN_GUEST=y
CONFIG_GENERIC_TRACER=y
CONFIG_SEV_GUEST=m
CONFIG_SCSI_IPR_TRACE=y
CONFIG_GUEST_PERF_EVENTS=y
CONFIG_HAVE_FTRACE_MCOUNT_RECORD=y
CONFIG_FTRACE_MCOUNT_RECORD=y
CONFIG_NOP_TRACER=y
CONFIG_KVM_SMM=y
CONFIG_ATH10K_TRACING=y
CONFIG_SAMPLE_TRACE_PRINTK=m
CONFIG_CONTEXT_SWITCH_TRACER=y
CONFIG_SAMPLE_TRACE_ARRAY=m
CONFIG_EVENT_TRACING=y
CONFIG_TRACE_CLOCK=y
CONFIG_IWLWIFI_DEVICE_TRACING=y
CONFIG_HAVE_KVM_PFNCACHE=y
CONFIG_KVM_INTEL=m
CONFIG_ATH12K_TRACING=y
CONFIG_OSNOISE_TRACER=y
```
