## documentation/resources/kernel/defconfig
```kconfig
CONFIG_64BIT=y
CONFIG_8139TOO_PIO=y
CONFIG_8139TOO=y
CONFIG_ACPI_AC=y
CONFIG_ACPI_BATTERY=y
CONFIG_ACPI_BGRT=y
CONFIG_ACPI_BUTTON=y
CONFIG_ACPI_CONTAINER=y
CONFIG_ACPI_CPPC_LIB=y
CONFIG_ACPI_CPU_FREQ_PSS=y
CONFIG_ACPI_DOCK=y
CONFIG_ACPI_FAN=y
CONFIG_ACPI_FPDT=y
CONFIG_ACPI_HOTPLUG_CPU=y
CONFIG_ACPI_HOTPLUG_IOAPIC=y
CONFIG_ACPI_I2C_OPREGION=y
CONFIG_ACPI_LEGACY_TABLES_LOOKUP=y
CONFIG_ACPI_LPIT=y
CONFIG_ACPI_MDIO=y
CONFIG_ACPI_NUMA=y
CONFIG_ACPI_PRMT=y
CONFIG_ACPI_PROCESSOR_CSTATE=y
CONFIG_ACPI_PROCESSOR_IDLE=y
CONFIG_ACPI_PROCESSOR=y
CONFIG_ACPI_REV_OVERRIDE_POSSIBLE=y
CONFIG_ACPI_SLEEP=y
CONFIG_ACPI_SPCR_TABLE=y
CONFIG_ACPI_SYSTEM_POWER_STATES_SUPPORT=y
CONFIG_ACPI_TABLE_UPGRADE=y
CONFIG_ACPI_THERMAL_REL=y
CONFIG_ACPI_THERMAL=y
CONFIG_ACPI_VIDEO=y
CONFIG_ACPI=y
CONFIG_AGP_AMD64=y
CONFIG_AGP_INTEL=y
CONFIG_AGP=y
CONFIG_ALLOW_DEV_COREDUMP=y
CONFIG_ALTERA_STAPL=y
CONFIG_AMD_IOMMU=y
CONFIG_AMD_MEM_ENCRYPT=y
CONFIG_AMD_NB=y
CONFIG_AMD_NUMA=y
CONFIG_APPLE_PROPERTIES=y
CONFIG_ARCH_CLOCKSOURCE_INIT=y
CONFIG_ARCH_DMA_ADDR_T_64BIT=y
CONFIG_ARCH_ENABLE_HUGEPAGE_MIGRATION=y
CONFIG_ARCH_ENABLE_MEMORY_HOTPLUG=y
CONFIG_ARCH_ENABLE_SPLIT_PMD_PTLOCK=y
CONFIG_ARCH_HAS_ACPI_TABLE_UPGRADE=y
CONFIG_ARCH_HAS_ADD_PAGES=y
CONFIG_ARCH_HAS_CACHE_LINE_SIZE=y
CONFIG_ARCH_HAS_CC_PLATFORM=y
CONFIG_ARCH_HAS_COPY_MC=y
CONFIG_ARCH_HAS_CPU_RELAX=y
CONFIG_ARCH_HAS_DEBUG_VIRTUAL=y
CONFIG_ARCH_HAS_DEBUG_VM_PGTABLE=y
CONFIG_ARCH_HAS_DEBUG_WX=y
CONFIG_ARCH_HAS_DEVMEM_IS_ALLOWED=y
CONFIG_ARCH_HAS_EARLY_DEBUG=y
CONFIG_ARCH_HAS_ELFCORE_COMPAT=y
CONFIG_ARCH_HAS_ELF_RANDOMIZE=y
CONFIG_ARCH_HAS_FAST_MULTIPLIER=y
CONFIG_ARCH_HAS_FILTER_PGPROT=y
CONFIG_ARCH_HAS_FORCE_DMA_UNENCRYPTED=y
CONFIG_ARCH_HAS_FORTIFY_SOURCE=y
CONFIG_ARCH_HAS_MEM_ENCRYPT=y
CONFIG_ARCH_HAS_PARANOID_L1D_FLUSH=y
CONFIG_ARCH_HAS_PKEYS=y
CONFIG_ARCH_HAS_PMEM_API=y
CONFIG_ARCH_HAS_PTE_DEVMAP=y
CONFIG_ARCH_HAS_PTE_SPECIAL=y
CONFIG_ARCH_HAS_RESTRICTED_VIRTIO_MEMORY_ACCESS=y
CONFIG_ARCH_HAS_SET_DIRECT_MAP=y
CONFIG_ARCH_HAS_SET_MEMORY=y
CONFIG_ARCH_HAS_STRICT_KERNEL_RWX=y
CONFIG_ARCH_HAS_STRICT_MODULE_RWX=y
CONFIG_ARCH_HAS_UACCESS_FLUSHCACHE=y
CONFIG_ARCH_HAS_UBSAN_SANITIZE_ALL=y
CONFIG_ARCH_HAS_ZONE_DMA_SET=y
CONFIG_ARCH_HAVE_NMI_SAFE_CMPXCHG=y
CONFIG_ARCH_HIBERNATION_HEADER=y
CONFIG_ARCH_HIBERNATION_POSSIBLE=y
CONFIG_ARCH_MAY_HAVE_PC_FDC=y
CONFIG_ARCH_MHP_MEMMAP_ON_MEMORY_ENABLE=y
CONFIG_ARCH_MIGHT_HAVE_ACPI_PDC=y
CONFIG_ARCH_MIGHT_HAVE_PC_PARPORT=y
CONFIG_ARCH_MIGHT_HAVE_PC_SERIO=y
CONFIG_ARCH_MMAP_RND_BITS=28
CONFIG_ARCH_MMAP_RND_BITS_MAX=32
CONFIG_ARCH_MMAP_RND_BITS_MIN=28
CONFIG_ARCH_MMAP_RND_COMPAT_BITS=8
CONFIG_ARCH_MMAP_RND_COMPAT_BITS_MAX=16
CONFIG_ARCH_MMAP_RND_COMPAT_BITS_MIN=8
CONFIG_ARCH_NR_GPIO=1024
CONFIG_ARCH_PROC_KCORE_TEXT=y
CONFIG_ARCH_RANDOM=y
CONFIG_ARCH_SELECT_MEMORY_MODEL=y
CONFIG_ARCH_SPARSEMEM_DEFAULT=y
CONFIG_ARCH_SPARSEMEM_ENABLE=y
CONFIG_ARCH_STACKWALK=y
CONFIG_ARCH_SUPPORTS_ACPI=y
CONFIG_ARCH_SUPPORTS_DEBUG_PAGEALLOC=y
CONFIG_ARCH_SUPPORTS_INT128=y
CONFIG_ARCH_SUPPORTS_LTO_CLANG_THIN=y
CONFIG_ARCH_SUPPORTS_LTO_CLANG=y
CONFIG_ARCH_SUPPORTS_MEMORY_FAILURE=y
CONFIG_ARCH_SUPPORTS_NUMA_BALANCING=y
CONFIG_ARCH_SUPPORTS_UPROBES=y
CONFIG_ARCH_SUSPEND_POSSIBLE=y
CONFIG_ARCH_USE_BUILTIN_BSWAP=y
CONFIG_ARCH_USE_CMPXCHG_LOCKREF=y
CONFIG_ARCH_USE_MEMREMAP_PROT=y
CONFIG_ARCH_USES_HIGH_VMA_FLAGS=y
CONFIG_ARCH_USES_PG_UNCACHED=y
CONFIG_ARCH_USE_SYM_ANNOTATIONS=y
CONFIG_ARCH_WANT_BATCHED_UNMAP_TLB_FLUSH=y
CONFIG_ARCH_WANT_COMPAT_IPC_PARSE_VERSION=y
CONFIG_ARCH_WANT_GENERAL_HUGETLB=y
CONFIG_ARCH_WANT_HUGE_PMD_SHARE=y
CONFIG_ARCH_WANT_LD_ORPHAN_WARN=y
CONFIG_ARCH_WANT_OLD_COMPAT_IPC=y
CONFIG_ARCH_WANTS_DYNAMIC_TASK_STRUCT=y
CONFIG_ARCH_WANTS_NO_INSTR=y
CONFIG_ARCH_WANTS_THP_SWAP=y
CONFIG_AS_AVX512=y
CONFIG_AS_IS_GNU=y
CONFIG_AS_SHA1_NI=y
CONFIG_AS_SHA256_NI=y
CONFIG_AS_TPAUSE=y
CONFIG_AS_VERSION=23501
CONFIG_ASYMMETRIC_KEY_TYPE=y
CONFIG_ASYMMETRIC_PUBLIC_KEY_SUBTYPE=y
CONFIG_ATA_ACPI=y
CONFIG_ATA_BMDMA=y
CONFIG_ATA_FORCE=y
CONFIG_ATA_PIIX=y
CONFIG_ATA_SFF=y
CONFIG_ATA_VERBOSE_ERROR=y
CONFIG_ATA=y
CONFIG_AUDIT_ARCH=y
CONFIG_BACKLIGHT_KTD253=y
CONFIG_BACKLIGHT_STEK_TAE=y
CONFIG_BCMA_POSSIBLE=y
CONFIG_BCM_VK=y
CONFIG_BCM_VK_TTY=y
CONFIG_BINFMT_ELF=y
CONFIG_BINFMT_MISC=y
CONFIG_BINFMT_SCRIPT=y
CONFIG_BLK_DEV_BSG=y
CONFIG_BLK_DEV_DM_BUILTIN=y
CONFIG_BLK_DEV_DM=y
CONFIG_BLK_DEV_LOOP_MIN_COUNT=8
CONFIG_BLK_DEV_LOOP=y
CONFIG_BLK_DEV_MD=y
CONFIG_BLK_DEV_SD=y
CONFIG_BLK_DEV_SR=y
CONFIG_BLK_DEV=y
CONFIG_CARDBUS=y
CONFIG_CC_CAN_LINK_STATIC=y
CONFIG_CC_CAN_LINK=y
CONFIG_CC_HAS_ASM_GOTO=y
CONFIG_CC_HAS_ASM_INLINE=y
CONFIG_CC_HAS_INT128=y
CONFIG_CC_HAS_KASAN_GENERIC=y
CONFIG_CC_HAS_NO_PROFILE_FN_ATTR=y
CONFIG_CC_HAS_SANE_STACKPROTECTOR=y
CONFIG_CC_IS_GCC=y
CONFIG_CC_VERSION_TEXT="gcc (SUSE Linux) 7.5.0"
CONFIG_CDROM=y
CONFIG_CEC_CORE=y
CONFIG_CHECK_SIGNATURE=y
CONFIG_CHR_DEV_SG=y
CONFIG_CHROME_PLATFORMS=y
CONFIG_CLANG_VERSION=0
CONFIG_CLKBLD_I8253=y
CONFIG_CLKEVT_I8253=y
CONFIG_CLOCKSOURCE_VALIDATE_LAST_CYCLE=y
CONFIG_CLOCKSOURCE_WATCHDOG=y
CONFIG_COMMON_CLK=y
CONFIG_COMPACTION=y
CONFIG_COMPAT_32BIT_TIME=y
CONFIG_COMPAT_32=y
CONFIG_COMPAT_BINFMT_ELF=y
CONFIG_COMPAT_FOR_U64_ALIGNMENT=y
CONFIG_COMPAT_OLD_SIGACTION=y
CONFIG_COMPAT=y
CONFIG_CONNECTOR=y
CONFIG_CONSOLE_POLL=y
CONFIG_CONSOLE_TRANSLATIONS=y
CONFIG_CONTEXT_TRACKING=y
CONFIG_CORE_DUMP_DEFAULT_ELF_HEADERS=y
CONFIG_COREDUMP=y
CONFIG_CPU_FREQ_DEFAULT_GOV_USERSPACE=y
CONFIG_CPU_FREQ_GOV_ATTR_SET=y
CONFIG_CPU_FREQ_GOV_COMMON=y
CONFIG_CPU_FREQ_GOV_ONDEMAND=y
CONFIG_CPU_FREQ_GOV_PERFORMANCE=y
CONFIG_CPU_FREQ_GOV_SCHEDUTIL=y
CONFIG_CPU_FREQ_GOV_USERSPACE=y
CONFIG_CPU_FREQ=y
CONFIG_CPU_IDLE_GOV_MENU=y
CONFIG_CPU_IDLE=y
CONFIG_CPUMASK_OFFSTACK=y
CONFIG_CPU_RMAP=y
CONFIG_CPU_SUP_AMD=y
CONFIG_CPU_SUP_CENTAUR=y
CONFIG_CPU_SUP_HYGON=y
CONFIG_CPU_SUP_INTEL=y
CONFIG_CPU_SUP_ZHAOXIN=y
CONFIG_CRASH_CORE=y
CONFIG_CRASH_DUMP=y
CONFIG_CRYPTO_DES3_EDE_X86_64=y
CONFIG_CRYPTO_DEV_CCP_CRYPTO=y
CONFIG_CRYPTO_DEV_CCP_DD=y
CONFIG_CRYPTO_DEV_CCP=y
CONFIG_CRYPTO_DEV_SP_CCP=y
CONFIG_CRYPTO_DEV_SP_PSP=y
CONFIG_CRYPTO_DEV_VIRTIO=y
CONFIG_CRYPTO_HW=y
CONFIG_CRYPTO_LIB_POLY1305_RSIZE=11
CONFIG_CXL_ACPI=y
CONFIG_CXL_BUS=y
CONFIG_CXL_MEM=y
CONFIG_DEBUG_BOOT_PARAMS=y
CONFIG_DEBUG_DEVRES=y
CONFIG_DEBUG_SHIRQ=y
CONFIG_DEBUG_WX=y
CONFIG_DEFAULT_MMAP_MIN_ADDR=65536
CONFIG_DEFAULT_SECURITY_SELINUX=y
CONFIG_DEVMEM=y
CONFIG_DEVPORT=y
CONFIG_DEVTMPFS_MOUNT=y
CONFIG_DEVTMPFS=y
CONFIG_DMA_ACPI=y
CONFIG_DMABUF_HEAPS_SYSTEM=y
CONFIG_DMABUF_HEAPS=y
CONFIG_DMABUF_SYSFS_STATS=y
CONFIG_DMA_COHERENT_POOL=y
CONFIG_DMADEVICES=y
CONFIG_DMA_ENGINE=y
CONFIG_DMA_OPS=y
CONFIG_DMAR_TABLE=y
CONFIG_DMA_SHARED_BUFFER=y
CONFIG_DMA_VIRTUAL_CHANNELS=y
CONFIG_DMIID=y
CONFIG_DMI_SCAN_MACHINE_NON_EFI_FALLBACK=y
CONFIG_DMI_SYSFS=y
CONFIG_DMI=y
CONFIG_DM_MIRROR=y
CONFIG_DM_ZERO=y
CONFIG_DQL=y
CONFIG_DRM_AMD_ACP=y
CONFIG_DRM_AMD_DC_HDCP=y
CONFIG_DRM_AMD_DC_SI=y
CONFIG_DRM_AMD_DC=y
CONFIG_DRM_AMDGPU_CIK=y
CONFIG_DRM_AMDGPU=y
CONFIG_DRM_AMDGPU_SI=y
CONFIG_DRM_AMDGPU_USERPTR=y
CONFIG_DRM_DP_CEC=y
CONFIG_DRM_I915_CAPTURE_ERROR=y
CONFIG_DRM_I915_COMPRESS_ERROR=y
CONFIG_DRM_I915_FENCE_TIMEOUT=10000
CONFIG_DRM_I915_FORCE_PROBE=""
CONFIG_DRM_I915_GVT=y
CONFIG_DRM_I915_HEARTBEAT_INTERVAL=2500
CONFIG_DRM_I915_MAX_REQUEST_BUSYWAIT=8000
CONFIG_DRM_I915_PREEMPT_TIMEOUT=640
CONFIG_DRM_I915_REQUEST_TIMEOUT=20000
CONFIG_DRM_I915_STOP_TIMEOUT=100
CONFIG_DRM_I915_TIMESLICE_DURATION=1
CONFIG_DRM_I915_USERFAULT_AUTOSUSPEND=250
CONFIG_DRM_I915_USERPTR=y
CONFIG_DRM_I915=y
CONFIG_DRM_LOAD_EDID_FIRMWARE=y
CONFIG_DRM_MIPI_DSI=y
CONFIG_DRM_SCHED=y
CONFIG_DRM_TTM_HELPER=y
CONFIG_DRM_TTM=y
CONFIG_DST_CACHE=y
CONFIG_DTPM=y
CONFIG_DW_DMAC_CORE=y
CONFIG_DWMAC_INTEL=y
CONFIG_DYNAMIC_FTRACE_WITH_ARGS=y
CONFIG_DYNAMIC_FTRACE_WITH_DIRECT_CALLS=y
CONFIG_DYNAMIC_MEMORY_LAYOUT=y
CONFIG_DYNAMIC_PHYSICAL_MASK=y
CONFIG_EARLY_PRINTK_DBGP=y
CONFIG_EARLY_PRINTK_USB_XDBC=y
CONFIG_EARLY_PRINTK_USB=y
CONFIG_EARLY_PRINTK=y
CONFIG_EDAC_ATOMIC_SCRUB=y
CONFIG_EDAC_DECODE_MCE=y
CONFIG_EDAC_LEGACY_SYSFS=y
CONFIG_EDAC_SUPPORT=y
CONFIG_EDAC=y
CONFIG_EDD=y
CONFIG_EFI_CUSTOM_SSDT_OVERLAYS=y
CONFIG_EFI_DEV_PATH_PARSER=y
CONFIG_EFI_EARLYCON=y
CONFIG_EFI_ESRT=y
CONFIG_EFI_GENERIC_STUB_INITRD_CMDLINE_LOADER=y
CONFIG_EFI_MIXED=y
CONFIG_EFI_RCI2_TABLE=y
CONFIG_EFI_RUNTIME_MAP=y
CONFIG_EFI_RUNTIME_WRAPPERS=y
CONFIG_EFI_STUB=y
CONFIG_EFI_TEST=y
CONFIG_EFIVAR_FS=y
CONFIG_EFI=y
CONFIG_ELFCORE=y
CONFIG_ETHTOOL_NETLINK=y
CONFIG_EXTRA_FIRMWARE_DIR="/lib/firmware"
CONFIG_EXTRA_FIRMWARE="i915/glk_dmc_ver1_04.bin i915/tgl_dmc_ver2_12.bin rtl_nic/rtl8168g-2.fw regulatory.db regulatory.db.p7s"
CONFIG_FB_TILEBLITTING=y
CONFIG_FDDI=y
CONFIG_FIB_RULES=y
CONFIG_FIRMWARE_MEMMAP=y
CONFIG_FIX_EARLYCON_MEM=y
CONFIG_FIXED_PHY=y
CONFIG_FORCEDETH=y
CONFIG_FRAME_WARN=2048
CONFIG_FTRACE_MCOUNT_USE_CC=y
CONFIG_FW_CFG_SYSFS=y
CONFIG_FW_LOADER=y
CONFIG_FWNODE_MDIO=y
CONFIG_GCC_VERSION=70500
CONFIG_GENERIC_BUG_RELATIVE_POINTERS=y
CONFIG_GENERIC_BUG=y
CONFIG_GENERIC_CALIBRATE_DELAY=y
CONFIG_GENERIC_CLOCKEVENTS_BROADCAST=y
CONFIG_GENERIC_CLOCKEVENTS_MIN_ADJUST=y
CONFIG_GENERIC_CLOCKEVENTS=y
CONFIG_GENERIC_CMOS_UPDATE=y
CONFIG_GENERIC_CPU_AUTOPROBE=y
CONFIG_GENERIC_CPU_VULNERABILITIES=y
CONFIG_GENERIC_CPU=y
CONFIG_GENERIC_EARLY_IOREMAP=y
CONFIG_GENERIC_ENTRY=y
CONFIG_GENERIC_IOMAP=y
CONFIG_GENERIC_IRQ_EFFECTIVE_AFF_MASK=y
CONFIG_GENERIC_IRQ_MATRIX_ALLOCATOR=y
CONFIG_GENERIC_IRQ_MIGRATION=y
CONFIG_GENERIC_IRQ_PROBE=y
CONFIG_GENERIC_IRQ_RESERVATION_MODE=y
CONFIG_GENERIC_IRQ_SHOW=y
CONFIG_GENERIC_ISA_DMA=y
CONFIG_GENERIC_MSI_IRQ_DOMAIN=y
CONFIG_GENERIC_MSI_IRQ=y
CONFIG_GENERIC_PCI_IOMAP=y
CONFIG_GENERIC_PENDING_IRQ=y
CONFIG_GENERIC_PINCONF=y
CONFIG_GENERIC_SMP_IDLE_THREAD=y
CONFIG_GENERIC_TIME_VSYSCALL=y
CONFIG_GNSS=y
CONFIG_GPIO_ACPI=y
CONFIG_GPIO_AMD_FCH=y
CONFIG_GPIO_AMDPT=y
CONFIG_GPIO_CDEV_V1=y
CONFIG_GPIO_CDEV=y
CONFIG_GPIO_GENERIC=y
CONFIG_GPIOLIB_FASTPATH_LIMIT=512
CONFIG_GPIOLIB_IRQCHIP=y
CONFIG_GPIOLIB=y
CONFIG_GRO_CELLS=y
CONFIG_HAMRADIO=y
CONFIG_HARDIRQS_SW_RESEND=y
CONFIG_HARDLOCKUP_CHECK_TIMESTAMP=y
CONFIG_HAS_DMA=y
CONFIG_HAS_IOMEM=y
CONFIG_HAS_IOPORT_MAP=y
CONFIG_HAVE_ACPI_APEI_NMI=y
CONFIG_HAVE_ACPI_APEI=y
CONFIG_HAVE_ALIGNED_STRUCT_PAGE=y
CONFIG_HAVE_ARCH_COMPAT_MMAP_BASES=y
CONFIG_HAVE_ARCH_HUGE_VMAP=y
CONFIG_HAVE_ARCH_JUMP_LABEL_RELATIVE=y
CONFIG_HAVE_ARCH_JUMP_LABEL=y
CONFIG_HAVE_ARCH_KASAN_VMALLOC=y
CONFIG_HAVE_ARCH_KASAN=y
CONFIG_HAVE_ARCH_KCSAN=y
CONFIG_HAVE_ARCH_KFENCE=y
CONFIG_HAVE_ARCH_KGDB=y
CONFIG_HAVE_ARCH_MMAP_RND_BITS=y
CONFIG_HAVE_ARCH_MMAP_RND_COMPAT_BITS=y
CONFIG_HAVE_ARCH_PREL32_RELOCATIONS=y
CONFIG_HAVE_ARCH_RANDOMIZE_KSTACK_OFFSET=y
CONFIG_HAVE_ARCH_SECCOMP_FILTER=y
CONFIG_HAVE_ARCH_SECCOMP=y
CONFIG_HAVE_ARCH_SOFT_DIRTY=y
CONFIG_HAVE_ARCH_STACKLEAK=y
CONFIG_HAVE_ARCH_THREAD_STRUCT_WHITELIST=y
CONFIG_HAVE_ARCH_TRACEHOOK=y
CONFIG_HAVE_ARCH_TRANSPARENT_HUGEPAGE_PUD=y
CONFIG_HAVE_ARCH_TRANSPARENT_HUGEPAGE=y
CONFIG_HAVE_ARCH_VMAP_STACK=y
CONFIG_HAVE_ARCH_WITHIN_STACK_FRAMES=y
CONFIG_HAVE_ASM_MODVERSIONS=y
CONFIG_HAVE_CLK_PREPARE=y
CONFIG_HAVE_CLK=y
CONFIG_HAVE_CMPXCHG_DOUBLE=y
CONFIG_HAVE_CMPXCHG_LOCAL=y
CONFIG_HAVE_CONTEXT_TRACKING_OFFSTACK=y
CONFIG_HAVE_CONTEXT_TRACKING=y
CONFIG_HAVE_DMA_CONTIGUOUS=y
CONFIG_HAVE_DYNAMIC_FTRACE_WITH_ARGS=y
CONFIG_HAVE_DYNAMIC_FTRACE_WITH_DIRECT_CALLS=y
CONFIG_HAVE_EFFICIENT_UNALIGNED_ACCESS=y
CONFIG_HAVE_EISA=y
CONFIG_HAVE_EXIT_THREAD=y
CONFIG_HAVE_FAST_GUP=y
CONFIG_HAVE_FENTRY=y
CONFIG_HAVE_FUNCTION_ARG_ACCESS_API=y
CONFIG_HAVE_FUNCTION_ERROR_INJECTION=y
CONFIG_HAVE_HARDENED_USERCOPY_ALLOCATOR=y
CONFIG_HAVE_HARDLOCKUP_DETECTOR_PERF=y
CONFIG_HAVE_HW_BREAKPOINT=y
CONFIG_HAVE_INTEL_TXT=y
CONFIG_HAVE_IOREMAP_PROT=y
CONFIG_HAVE_IRQ_EXIT_ON_IRQ_STACK=y
CONFIG_HAVE_IRQ_TIME_ACCOUNTING=y
CONFIG_HAVE_KERNEL_BZIP2=y
CONFIG_HAVE_KERNEL_GZIP=y
CONFIG_HAVE_KERNEL_LZ4=y
CONFIG_HAVE_KERNEL_LZMA=y
CONFIG_HAVE_KERNEL_LZO=y
CONFIG_HAVE_KERNEL_XZ=y
CONFIG_HAVE_KERNEL_ZSTD=y
CONFIG_HAVE_KPROBES_ON_FTRACE=y
CONFIG_HAVE_KVM_CPU_RELAX_INTERCEPT=y
CONFIG_HAVE_KVM_EVENTFD=y
CONFIG_HAVE_KVM_IRQ_BYPASS=y
CONFIG_HAVE_KVM_IRQCHIP=y
CONFIG_HAVE_KVM_IRQFD=y
CONFIG_HAVE_KVM_IRQ_ROUTING=y
CONFIG_HAVE_KVM_MSI=y
CONFIG_HAVE_KVM_NO_POLL=y
CONFIG_HAVE_KVM_PM_NOTIFIER=y
CONFIG_HAVE_KVM=y
CONFIG_HAVE_LIVEPATCH=y
CONFIG_HAVE_MIXED_BREAKPOINTS_REGS=y
CONFIG_HAVE_MMIOTRACE_SUPPORT=y
CONFIG_HAVE_MOD_ARCH_SPECIFIC=y
CONFIG_HAVE_MOVE_PMD=y
CONFIG_HAVE_MOVE_PUD=y
CONFIG_HAVE_NMI=y
CONFIG_HAVE_OBJTOOL_MCOUNT=y
CONFIG_HAVE_OPTPROBES=y
CONFIG_HAVE_PCI=y
CONFIG_HAVE_PERF_EVENTS_NMI=y
CONFIG_HAVE_PERF_REGS=y
CONFIG_HAVE_PERF_USER_STACK_DUMP=y
CONFIG_HAVE_PREEMPT_DYNAMIC=y
CONFIG_HAVE_REGS_AND_STACK_ACCESS_API=y
CONFIG_HAVE_RELIABLE_STACKTRACE=y
CONFIG_HAVE_RSEQ=y
CONFIG_HAVE_SCHED_AVG_IRQ=y
CONFIG_HAVE_SETUP_PER_CPU_AREA=y
CONFIG_HAVE_SOFTIRQ_ON_OWN_STACK=y
CONFIG_HAVE_STACKPROTECTOR=y
CONFIG_HAVE_STACK_VALIDATION=y
CONFIG_HAVE_STATIC_CALL_INLINE=y
CONFIG_HAVE_STATIC_CALL=y
CONFIG_HAVE_UNSTABLE_SCHED_CLOCK=y
CONFIG_HAVE_USER_RETURN_NOTIFIER=y
CONFIG_HAVE_VIRT_CPU_ACCOUNTING_GEN=y
CONFIG_HEADERS_INSTALL=y
CONFIG_HIBERNATE_CALLBACKS=y
CONFIG_HIBERNATION_SNAPSHOT_DEV=y
CONFIG_HIBERNATION=y
CONFIG_HIST_TRIGGERS=y
CONFIG_HMM_MIRROR=y
CONFIG_HOTPLUG_CPU=y
CONFIG_HOTPLUG_PCI=y
CONFIG_HOTPLUG_SMT=y
CONFIG_HPET_EMULATE_RTC=y
CONFIG_HPET_TIMER=y
CONFIG_HPET=y
CONFIG_HSA_AMD=y
CONFIG_HSU_DMA=y
CONFIG_HW_CONSOLE=y
CONFIG_HWMON=y
CONFIG_HW_RANDOM_VIA=y
CONFIG_HW_RANDOM=y
CONFIG_HZ=1000
CONFIG_HZ_1000=y
CONFIG_I2C_ALGOBIT=y
CONFIG_I2C_BOARDINFO=y
CONFIG_I2C_COMPAT=y
CONFIG_I2C_HELPER_AUTO=y
CONFIG_I2C_I801=y
CONFIG_I2C_SMBUS=y
CONFIG_I2C=y
CONFIG_I8253_LOCK=y
CONFIG_IA32_EMULATION=y
CONFIG_IA32_FEAT_CTL=y
CONFIG_IDLE_INJECT=y
CONFIG_IGC=y
CONFIG_ILLEGAL_POINTER_VALUE=0xdead000000000000
CONFIG_INIT_STACK_NONE=y
CONFIG_INSTRUCTION_DECODER=y
CONFIG_INT3406_THERMAL=y
CONFIG_INT340X_THERMAL=y
CONFIG_INTEGRITY_AUDIT=y
CONFIG_INTEGRITY=y
CONFIG_INTEL_ATOMISP2_PDX86=y
CONFIG_INTEL_ATOMISP2_PM=y
CONFIG_INTEL_GTT=y
CONFIG_INTEL_IDMA64=y
CONFIG_INTEL_IOMMU_FLOPPY_WA=y
CONFIG_INTEL_IOMMU_SCALABLE_MODE_DEFAULT_ON=y
CONFIG_INTEL_IOMMU=y
CONFIG_INTEL_MEI_HDCP=y
CONFIG_INTEL_MEI=y
CONFIG_INTEL_MEI_ME=y
CONFIG_INTEL_MEI_TXE=y
CONFIG_INTEL_PCH_THERMAL=y
CONFIG_INTEL_PMC_CORE=y
CONFIG_INTEL_POWERCLAMP=y
CONFIG_INTEL_RAPL_CORE=y
CONFIG_INTEL_RAPL=y
CONFIG_INTEL_SAR_INT1092=y
CONFIG_INTEL_SCU_IPC=y
CONFIG_INTEL_SCU_PCI=y
CONFIG_INTEL_SCU=y
CONFIG_INTEL_SMARTCONNECT=y
CONFIG_INTEL_SOC_DTS_IOSF_CORE=y
CONFIG_INTEL_SOC_DTS_THERMAL=y
CONFIG_INTEL_TCC_COOLING=y
CONFIG_INTEL_TURBO_MAX_3=y
CONFIG_IOASID=y
CONFIG_IO_DELAY_0X80=y
CONFIG_IOMMU_API=y
CONFIG_IOMMU_DEFAULT_DMA_LAZY=y
CONFIG_IOMMU_DMA=y
CONFIG_IOMMU_IO_PGTABLE=y
CONFIG_IOMMU_IOVA=y
CONFIG_IOMMU_SUPPORT=y
CONFIG_IOSF_MBI=y
CONFIG_IRQ_BYPASS_MANAGER=y
CONFIG_IRQ_DOMAIN_HIERARCHY=y
CONFIG_IRQ_DOMAIN=y
CONFIG_IRQ_FORCED_THREADING=y
CONFIG_IRQ_MSI_IOMMU=y
CONFIG_IRQ_TIME_ACCOUNTING=y
CONFIG_IRQ_WORK=y
CONFIG_ISA_DMA_API=y
CONFIG_JUMP_LABEL=y
CONFIG_KERNEL_GZIP=y
CONFIG_KEXEC_CORE=y
CONFIG_KEXEC=y
CONFIG_KEYS=y
CONFIG_KFENCE_NUM_OBJECTS=255
CONFIG_KFENCE_SAMPLE_INTERVAL=0
CONFIG_KFENCE_STRESS_TEST_FAULTS=0
CONFIG_KFENCE=y
CONFIG_KGDB_HONOUR_BLOCKLIST=y
CONFIG_KGDB_LOW_LEVEL_TRAP=y
CONFIG_KGDB_SERIAL_CONSOLE=y
CONFIG_KGDB_TESTS=y
CONFIG_KGDB=y
CONFIG_KPROBES_ON_FTRACE=y
CONFIG_KVM_AMD_SEV=y
CONFIG_KVM_AMD=y
CONFIG_KVM_ASYNC_PF=y
CONFIG_KVM_COMPAT=y
CONFIG_KVM_GENERIC_DIRTYLOG_READ_PROTECT=y
CONFIG_KVM_INTEL=y
CONFIG_KVM_MMIO=y
CONFIG_KVM_VFIO=y
CONFIG_KVM_WERROR=y
CONFIG_KVM_XFER_TO_GUEST_WORK=y
CONFIG_KVM=y
CONFIG_LD_IS_BFD=y
CONFIG_LDISC_AUTOLOAD=y
CONFIG_LD_VERSION=23501
CONFIG_LEDS_CLASS=y
CONFIG_LEDS_TRIGGERS=y
CONFIG_LEGACY_VSYSCALL_XONLY=y
CONFIG_LLD_VERSION=0
CONFIG_LOCKDEP_SUPPORT=y
CONFIG_LOG_BUF_SHIFT=18
CONFIG_LOG_CPU_MAX_BUF_SHIFT=12
CONFIG_LPC_ICH=y
CONFIG_LPC_SCH=y
CONFIG_LSM="lockdown,yama,integrity,selinux,bpf,landlock"
CONFIG_LSM_MMAP_MIN_ADDR=65535
CONFIG_LTO_NONE=y
CONFIG_MAC_EMUMOUSEBTN=y
CONFIG_MACINTOSH_DRIVERS=y
CONFIG_MAGIC_SYSRQ_DEFAULT_ENABLE=0x0
CONFIG_MAILBOX=y
CONFIG_MAXSMP=y
CONFIG_MCTP=y
CONFIG_MD_AUTODETECT=y
CONFIG_MDIO_BCM_UNIMAC=y
CONFIG_MDIO_BITBANG=y
CONFIG_MDIO_BUS=y
CONFIG_MDIO_DEVICE=y
CONFIG_MDIO_DEVRES=y
CONFIG_MDIO_MVUSB=y
CONFIG_MD=y
CONFIG_MELLANOX_PLATFORM=y
CONFIG_MFD_CORE=y
CONFIG_MFD_INTEL_LPSS_ACPI=y
CONFIG_MFD_INTEL_LPSS_PCI=y
CONFIG_MFD_INTEL_LPSS=y
CONFIG_MHI_BUS=y
CONFIG_MHI_BUS_PCI_GENERIC=y
CONFIG_MICROCODE_AMD=y
CONFIG_MICROCODE_INTEL=y
CONFIG_MICROCODE=y
CONFIG_MIGRATION=y
CONFIG_MII=y
CONFIG_MMC=y
CONFIG_MMC_BLOCK=y
CONFIG_MMC_BLOCK_MINORS=8
CONFIG_MMC_SDHCI=y
CONFIG_MMC_SDHCI_IO_ACCESSORS=y
CONFIG_MMC_SDHCI_PCI=y
CONFIG_MMC_CQHCI=y
CONFIG_MMCONF_FAM10H=y
CONFIG_MMIOTRACE=y
CONFIG_MMU_NOTIFIER=y
CONFIG_MMU=y
CONFIG_MODIFY_LDT_SYSCALL=y
CONFIG_MODULES_USE_ELF_RELA=y
CONFIG_MTRR=y
CONFIG_NEED_DMA_MAP_STATE=y
CONFIG_NEED_PER_CPU_EMBED_FIRST_CHUNK=y
CONFIG_NEED_PER_CPU_PAGE_FIRST_CHUNK=y
CONFIG_NEED_SG_DMA_LENGTH=y
CONFIG_NET_9P_VIRTIO=y
CONFIG_NET_9P=y
CONFIG_NETCONSOLE=y
CONFIG_NET_CORE=y
CONFIG_NETDEVICES=y
CONFIG_NET_POLL_CONTROLLER=y
CONFIG_NETPOLL=y
CONFIG_NET_SELFTESTS=y
CONFIG_NET_TULIP=y
CONFIG_NEW_LEDS=y
CONFIG_N_GSM=y
CONFIG_N_HDLC=y
CONFIG_NODES_SHIFT=10
CONFIG_NO_HZ_COMMON=y
CONFIG_NO_HZ_FULL=y
CONFIG_NO_HZ=y
CONFIG_NOZOMI=y
CONFIG_NR_CPUS=8192
CONFIG_NR_CPUS_DEFAULT=8192
CONFIG_NR_CPUS_RANGE_BEGIN=8192
CONFIG_NR_CPUS_RANGE_END=8192
CONFIG_NULL_TTY=y
CONFIG_NUMA=y
CONFIG_NVMEM_RMEM=y
CONFIG_NVMEM_SYSFS=y
CONFIG_NVMEM=y
CONFIG_NVRAM=y
CONFIG_OLD_SIGSUSPEND3=y
CONFIG_OPTPROBES=y
CONFIG_OUTPUT_FORMAT="elf64-x86-64"
CONFIG_PAGE_EXTENSION=y
CONFIG_PAGE_POOL=y
CONFIG_PAGE_REPORTING=y
CONFIG_PATA_AMD=y
CONFIG_PATA_OLDPIIX=y
CONFIG_PATA_SCH=y
CONFIG_PATA_TIMINGS=y
CONFIG_PCCARD_NONSTATIC=y
CONFIG_PCCARD=y
CONFIG_PCC=y
CONFIG_PCI_ATS=y
CONFIG_PCI_DIRECT=y
CONFIG_PCI_DOMAINS=y
CONFIG_PCIEAER=y
CONFIG_PCIEASPM_DEFAULT=y
CONFIG_PCIEASPM=y
CONFIG_PCIE_BUS_DEFAULT=y
CONFIG_PCIE_PME=y
CONFIG_PCIEPORTBUS=y
CONFIG_PCI_LABEL=y
CONFIG_PCI_LOCKLESS_CONFIG=y
CONFIG_PCI_MMCONFIG=y
CONFIG_PCI_MSI_IRQ_DOMAIN=y
CONFIG_PCI_MSI=y
CONFIG_PCI_PASID=y
CONFIG_PCI_PRI=y
CONFIG_PCI_QUIRKS=y
CONFIG_PCI=y
CONFIG_PCMCIA_LOAD_CIS=y
CONFIG_PCMCIA=y
CONFIG_PCS_XPCS=y
CONFIG_PCS_XPCS=y
CONFIG_PERF_EVENTS_INTEL_CSTATE=y
CONFIG_PERF_EVENTS_INTEL_RAPL=y
CONFIG_PERF_EVENTS_INTEL_UNCORE=y
CONFIG_PGTABLE_LEVELS=4
CONFIG_PHYLIB=y
CONFIG_PHYLINK=y
CONFIG_PHYS_ADDR_T_64BIT=y
CONFIG_PHYSICAL_ALIGN=0x1000000
CONFIG_PHYSICAL_START=0x1000000
CONFIG_PINCONF=y
CONFIG_PINCTRL_ALDERLAKE=y
CONFIG_PINCTRL_AMD=y
CONFIG_PINCTRL_BAYTRAIL=y
CONFIG_PINCTRL_BROXTON=y
CONFIG_PINCTRL_CANNONLAKE=y
CONFIG_PINCTRL_CEDARFORK=y
CONFIG_PINCTRL_CHERRYVIEW=y
CONFIG_PINCTRL_DENVERTON=y
CONFIG_PINCTRL_ELKHARTLAKE=y
CONFIG_PINCTRL_EMMITSBURG=y
CONFIG_PINCTRL_GEMINILAKE=y
CONFIG_PINCTRL_ICELAKE=y
CONFIG_PINCTRL_INTEL=y
CONFIG_PINCTRL_JASPERLAKE=y
CONFIG_PINCTRL_LAKEFIELD=y
CONFIG_PINCTRL_LEWISBURG=y
CONFIG_PINCTRL_LYNXPOINT=y
CONFIG_PINCTRL_MCP23S08_I2C=y
CONFIG_PINCTRL_MCP23S08=y
CONFIG_PINCTRL_SUNRISEPOINT=y
CONFIG_PINCTRL_SX150X=y
CONFIG_PINCTRL_TIGERLAKE=y
CONFIG_PINCTRL=y
CONFIG_PINMUX=y
CONFIG_PKCS7_MESSAGE_PARSER=y
CONFIG_PMC_ATOM=y
CONFIG_PM_CLK=y
CONFIG_PM_DEBUG=y
CONFIG_PMIC_OPREGION=y
CONFIG_PM_SLEEP_DEBUG=y
CONFIG_PM_SLEEP_SMP=y
CONFIG_PM_SLEEP=y
CONFIG_PM_STD_PARTITION=""
CONFIG_PM_TRACE_RTC=y
CONFIG_PM_TRACE=y
CONFIG_PM=y
CONFIG_PNPACPI=y
CONFIG_PNP_DEBUG_MESSAGES=y
CONFIG_PNP=y
CONFIG_POWERCAP=y
CONFIG_POWER_SUPPLY_HWMON=y
CONFIG_POWER_SUPPLY=y
CONFIG_PPP_ASYNC=y
CONFIG_PPP_BSDCOMP=y
CONFIG_PPP_DEFLATE=y
CONFIG_PPP_FILTER=y
CONFIG_PPP=y
CONFIG_PPP_MPPE=y
CONFIG_PPP_MULTILINK=y
CONFIG_PPPOE=y
CONFIG_PPP_SYNC_TTY=y
CONFIG_PPS=y
CONFIG_PREEMPT_NOTIFIERS=y
CONFIG_PREVENT_FIRMWARE_BUILD=y
CONFIG_PRINTK_SAFE_LOG_BUF_SHIFT=12
CONFIG_PROC_EVENTS=y
CONFIG_PROC_THERMAL_MMIO_RAPL=y
CONFIG_PROVIDE_OHCI1394_DMA_INIT=y
CONFIG_PTP_1588_CLOCK_IDT82P33=y
CONFIG_PTP_1588_CLOCK_IDTCM=y
CONFIG_PTP_1588_CLOCK_OPTIONAL=y
CONFIG_PTP_1588_CLOCK=y
CONFIG_PVPANIC_MMIO=y
CONFIG_PVPANIC=y
CONFIG_R8169=y
CONFIG_RANDOMIZE_BASE=y
CONFIG_RANDOMIZE_MEMORY_PHYSICAL_PADDING=0xa
CONFIG_RANDOMIZE_MEMORY=y
CONFIG_RAS=y
CONFIG_RCU_CPU_STALL_TIMEOUT=60
CONFIG_REALTEK_PHY=y
CONFIG_REGMAP_I2C=y
CONFIG_REGMAP_MMIO=y
CONFIG_REGMAP=y
CONFIG_RELOCATABLE=y
CONFIG_RESET_CONTROLLER=y
CONFIG_RESET_DISPMIX=y
CONFIG_RTC_CLASS=y
CONFIG_RTC_DRV_CMOS=y
CONFIG_RTC_I2C_AND_SPI=y
CONFIG_RTC_INTF_DEV=y
CONFIG_RTC_INTF_PROC=y
CONFIG_RTC_INTF_SYSFS=y
CONFIG_RTC_LIB=y
CONFIG_RTC_MC146818_LIB=y
CONFIG_RTC_NVMEM=y
CONFIG_RTC_SYSTOHC_DEVICE="rtc0"
CONFIG_RTC_SYSTOHC=y
CONFIG_SATA_AHCI=y
CONFIG_SATA_HOST=y
CONFIG_SATA_MOBILE_LPM_POLICY=3
CONFIG_SATA_PMP=y
CONFIG_SCHED_HRTICK=y
CONFIG_SCHED_MC_PRIO=y
CONFIG_SCHED_MC=y
CONFIG_SCHED_OMIT_FRAME_POINTER=y
CONFIG_SCHED_SMT=y
CONFIG_SCHED_STACK_END_CHECK=y
CONFIG_SCSI_COMMON=y
CONFIG_SCSI_CONSTANTS=y
CONFIG_SCSI_DMA=y
CONFIG_SCSI_MOD=y
CONFIG_SCSI_PROC_FS=y
CONFIG_SCSI_SPI_ATTRS=y
CONFIG_SCSI=y
CONFIG_SECCOMP_FILTER=y
CONFIG_SECCOMP=y
CONFIG_SECTION_MISMATCH_WARN_ONLY=y
CONFIG_SECURITY_NETWORK=y
CONFIG_SECURITY_SELINUX_AVC_STATS=y
CONFIG_SECURITY_SELINUX_BOOTPARAM=y
CONFIG_SECURITY_SELINUX_CHECKREQPROT_VALUE=0
CONFIG_SECURITY_SELINUX_DEVELOP=y
CONFIG_SECURITY_SELINUX_DISABLE=y
CONFIG_SECURITY_SELINUX_SID2STR_CACHE_SIZE=256
CONFIG_SECURITY_SELINUX_SIDTAB_HASH_BITS=9
CONFIG_SECURITY_SELINUX=y
CONFIG_SECURITY_WRITABLE_HOOKS=y
CONFIG_SECURITY=y
CONFIG_SELECT_MEMORY_MODEL=y
CONFIG_SENSORS_CORETEMP=y
CONFIG_SENSORS_FAM15H_POWER=y
CONFIG_SENSORS_I5500=y
CONFIG_SENSORS_K10TEMP=y
CONFIG_SENSORS_LIS3_I2C=y
CONFIG_SENSORS_LIS3LV02D=y
CONFIG_SENSORS_NCT6775=y
CONFIG_SERIAL_8250_CONSOLE=y
CONFIG_SERIAL_8250_DEPRECATED_OPTIONS=y
CONFIG_SERIAL_8250_DETECT_IRQ=y
CONFIG_SERIAL_8250_DMA=y
CONFIG_SERIAL_8250_DWLIB=y
CONFIG_SERIAL_8250_DW=y
CONFIG_SERIAL_8250_EXAR=y
CONFIG_SERIAL_8250_EXTENDED=y
CONFIG_SERIAL_8250_LPSS=y
CONFIG_SERIAL_8250_MANY_PORTS=y
CONFIG_SERIAL_8250_MID=y
CONFIG_SERIAL_8250_NR_UARTS=32
CONFIG_SERIAL_8250_PCI=y
CONFIG_SERIAL_8250_PNP=y
CONFIG_SERIAL_8250_RSA=y
CONFIG_SERIAL_8250_RUNTIME_UARTS=32
CONFIG_SERIAL_8250_SHARE_IRQ=y
CONFIG_SERIAL_8250=y
CONFIG_SERIAL_CORE_CONSOLE=y
CONFIG_SERIAL_CORE=y
CONFIG_SERIAL_EARLYCON=y
CONFIG_SERIAL_MCTRL_GPIO=y
CONFIG_SERIAL_NONSTANDARD=y
CONFIG_SERIO_I8042=y
CONFIG_SERIO_LIBPS2=y
CONFIG_SERIO_SERPORT=y
CONFIG_SERIO=y
CONFIG_SGL_ALLOC=y
CONFIG_SG_POOL=y
CONFIG_SKY2=y
CONFIG_SLHC=y
CONFIG_SLIP_COMPRESSED=y
CONFIG_SLIP=y
CONFIG_SLIP_SMART=y
CONFIG_SMP=y
CONFIG_SND_COMPRESS_OFFLOAD=y
CONFIG_SND_DMA_SGBUF=y
CONFIG_SND_DRIVERS=y
CONFIG_SND_HDA_CODEC_REALTEK=y
CONFIG_SND_HDA_COMPONENT=y
CONFIG_SND_HDA_CORE=y
CONFIG_SND_HDA_HWDEP=y
CONFIG_SND_HDA_I915=y
CONFIG_SND_HDA_INTEL_HDMI_SILENT_STREAM=y
CONFIG_SND_HDA_INTEL=y
CONFIG_SND_HDA_POWER_SAVE_DEFAULT=0
CONFIG_SND_HDA_PREALLOC_SIZE=0
CONFIG_SND_HDA=y
CONFIG_SND_HRTIMER=y
CONFIG_SND_HWDEP=y
CONFIG_SND_INTEL_DSP_CONFIG=y
CONFIG_SND_INTEL_NHLT=y
CONFIG_SND_INTEL_SOUNDWIRE_ACPI=y
CONFIG_SND_JACK_INPUT_DEV=y
CONFIG_SND_JACK=y
CONFIG_SND_PCI=y
CONFIG_SND_PCMCIA=y
CONFIG_SND_PCM_TIMER=y
CONFIG_SND_PCM=y
CONFIG_SND_PROC_FS=y
CONFIG_SND_SEQ_DEVICE=y
CONFIG_SND_SEQ_DUMMY=y
CONFIG_SND_SEQ_HRTIMER_DEFAULT=y
CONFIG_SND_SEQUENCER=y
CONFIG_SND_SOC_ACPI=y
CONFIG_SND_SOC_AMD_RENOIR=y
CONFIG_SND_SOC_AMD_RENOIR_MACH=y
CONFIG_SND_SOC_COMPRESS=y
CONFIG_SND_SOC_DMIC=y
CONFIG_SND_SOC=y
CONFIG_SND_SUPPORT_OLD_API=y
CONFIG_SND_TIMER=y
CONFIG_SND_USB=y
CONFIG_SND_VERBOSE_PROCFS=y
CONFIG_SND_VMASTER=y
CONFIG_SND_X86=y
CONFIG_SND=y
CONFIG_SOUND=y
CONFIG_SPARSE_IRQ=y
CONFIG_SPARSEMEM_EXTREME=y
CONFIG_SPARSEMEM_MANUAL=y
CONFIG_SPARSEMEM_VMEMMAP_ENABLE=y
CONFIG_SPARSEMEM_VMEMMAP=y
CONFIG_SPARSEMEM=y
CONFIG_SPLIT_PTLOCK_CPUS=4
CONFIG_SSB_POSSIBLE=y
CONFIG_STACKPROTECTOR=y
CONFIG_STACKTRACE_SUPPORT=y
CONFIG_STACK_VALIDATION=y
CONFIG_STANDALONE=y
CONFIG_STMMAC_ETH=y
CONFIG_STRICT_DEVMEM=y
CONFIG_STRICT_KERNEL_RWX=y
CONFIG_STRICT_MODULE_RWX=y
CONFIG_SURFACE_PLATFORMS=y
CONFIG_SUSPEND_FREEZER=y
CONFIG_SUSPEND=y
CONFIG_SWIOTLB=y
CONFIG_SWPHY=y
CONFIG_SYNC_FILE=y
CONFIG_SYNCLINK_GT=y
CONFIG_SYNTH_EVENTS=y
CONFIG_SYSFB=y
CONFIG_SYSTEM_TRUSTED_KEYRING=y
CONFIG_SYSTEM_TRUSTED_KEYS=""
CONFIG_SYSVIPC_COMPAT=y
CONFIG_THERMAL_DEFAULT_GOV_STEP_WISE=y
CONFIG_THERMAL_EMERGENCY_POWEROFF_DELAY_MS=0
CONFIG_THERMAL_GOV_STEP_WISE=y
CONFIG_THERMAL_GOV_USER_SPACE=y
CONFIG_THERMAL_HWMON=y
CONFIG_THERMAL_NETLINK=y
CONFIG_THERMAL_WRITABLE_TRIPS=y
CONFIG_THERMAL=y
CONFIG_TICK_ONESHOT=y
CONFIG_TIGON3_HWMON=y
CONFIG_TIGON3=y
CONFIG_TRACE_IRQFLAGS_NMI_SUPPORT=y
CONFIG_TRACE_IRQFLAGS_SUPPORT=y
CONFIG_TRACING_MAP=y
CONFIG_TTY=y
CONFIG_UACCE=y
CONFIG_UNIX98_PTYS=y
CONFIG_UNWINDER_ORC=y
CONFIG_USB_ANNOUNCE_NEW_DEVICES=y
CONFIG_USB_ARCH_HAS_HCD=y
CONFIG_USB_AUTOSUSPEND_DELAY=2
CONFIG_USB_COMMON=y
CONFIG_USB_DEFAULT_PERSIST=y
CONFIG_USB_EHCI_HCD=y
CONFIG_USB_EHCI_PCI=y
CONFIG_USB_EHCI_TT_NEWSCHED=y
CONFIG_USB_MON=y
CONFIG_USB_NET_DRIVERS=y
CONFIG_USB_OHCI_HCD_PCI=y
CONFIG_USB_OHCI_HCD=y
CONFIG_USB_OHCI_LITTLE_ENDIAN=y
CONFIG_USB_PCI=y
CONFIG_USB_PRINTER=y
CONFIG_USB_STORAGE=y
CONFIG_USB_SUPPORT=y
CONFIG_USB_UHCI_HCD=y
CONFIG_USB_XHCI_HCD=y
CONFIG_USB_XHCI_PCI_RENESAS=y
CONFIG_USB_XHCI_PCI=y
CONFIG_USB=y
CONFIG_USE_PERCPU_NUMA_NODE_ID=y
CONFIG_USER_RETURN_NOTIFIER=y
CONFIG_USER_STACKTRACE_SUPPORT=y
CONFIG_VGA_CONSOLE=y
CONFIG_VHOST_MENU=y
CONFIG_VIRT_CPU_ACCOUNTING_GEN=y
CONFIG_VIRT_CPU_ACCOUNTING=y
CONFIG_VIRTIO_MENU=y
CONFIG_VIRTIO_MMIO=y
CONFIG_VIRTIO_PCI_LEGACY=y
CONFIG_VIRTIO_PCI_LIB=y
CONFIG_VIRTIO_PCI=y
CONFIG_VIRTIO=y
CONFIG_VIRT_TO_BUS=y
CONFIG_VIRTUALIZATION=y
CONFIG_VMAP_PFN=y
CONFIG_VMAP_STACK=y
CONFIG_VMWARE_VMCI=y
CONFIG_VT_CONSOLE_SLEEP=y
CONFIG_VT_CONSOLE=y
CONFIG_VT_HW_CONSOLE_BINDING=y
CONFIG_VT=y
CONFIG_WATCHDOG_CORE=y
CONFIG_WATCHDOG_HANDLE_BOOT_ENABLED=y
CONFIG_WATCHDOG_OPEN_TIMEOUT=0
CONFIG_WATCHDOG=y
CONFIG_X509_CERTIFICATE_PARSER=y
CONFIG_X86_16BIT=y
CONFIG_X86_64_ACPI_NUMA=y
CONFIG_X86_64_SMP=y
CONFIG_X86_64=y
CONFIG_X86_ACPI_CPUFREQ_CPB=y
CONFIG_X86_ACPI_CPUFREQ=y
CONFIG_X86_AMD_PLATFORM_DEVICE=y
CONFIG_X86_BOOTPARAM_MEMORY_CORRUPTION_CHECK=y
CONFIG_X86_CHECK_BIOS_CORRUPTION=y
CONFIG_X86_CMOV=y
CONFIG_X86_CMPXCHG64=y
CONFIG_X86_CPUID=y
CONFIG_X86_DEBUGCTLMSR=y
CONFIG_X86_DECODER_SELFTEST=y
CONFIG_X86_DIRECT_GBPAGES=y
CONFIG_X86_ESPFIX64=y
CONFIG_X86_EXTENDED_PLATFORM=y
CONFIG_X86_FEATURE_NAMES=y
CONFIG_X86_INTEL_LPSS=y
CONFIG_X86_INTEL_MEMORY_PROTECTION_KEYS=y
CONFIG_X86_INTEL_PSTATE=y
CONFIG_X86_INTEL_TSX_MODE_OFF=y
CONFIG_X86_INTERNODE_CACHE_SHIFT=6
CONFIG_X86_IO_APIC=y
CONFIG_X86_IOPL_IOPERM=y
CONFIG_X86_L1_CACHE_SHIFT=6
CONFIG_X86_LOCAL_APIC=y
CONFIG_X86_MCE_AMD=y
CONFIG_X86_MCE_INTEL=y
CONFIG_X86_MCE_THRESHOLD=y
CONFIG_X86_MCE=y
CONFIG_X86_MINIMUM_CPU_FAMILY=64
CONFIG_X86_MPPARSE=y
CONFIG_X86_MSR=y
CONFIG_X86_NEED_RELOCS=y
CONFIG_X86_PAT=y
CONFIG_X86_PKG_TEMP_THERMAL=y
CONFIG_X86_PLATFORM_DEVICES=y
CONFIG_X86_PM_TIMER=y
CONFIG_X86_REROUTE_FOR_BROKEN_BOOT_IRQS=y
CONFIG_X86_SGX_KVM=y
CONFIG_X86_SMAP=y
CONFIG_X86_SUPPORTS_MEMORY_FAILURE=y
CONFIG_X86_THERMAL_VECTOR=y
CONFIG_X86_TSC=y
CONFIG_X86_UMIP=y
CONFIG_X86_VMX_FEATURE_NAMES=y
CONFIG_X86_VSYSCALL_EMULATION=y
CONFIG_X86=y
CONFIG_YENTA_ENE_TUNE=y
CONFIG_YENTA_O2=y
CONFIG_YENTA_RICOH=y
CONFIG_YENTA_TI=y
CONFIG_YENTA_TOSHIBA=y
CONFIG_YENTA=y
CONFIG_ZONE_DMA32=y
CONFIG_ZONE_DMA=y
# from steven 1
CONFIG_VSOCKETS=y
CONFIG_VHOST_VSOCK=y
CONFIG_VIRTIO_VSOCKETS=y
CONFIG_VIRTIO_VSOCKETS_COMMON=y
CONFIG_VSOCKETS_DIAG=y
CONFIG_VSOCKETS_LOOPBACK=y
# from steven 2
CONFIG_TRACING=y  
CONFIG_FTRACE=y  
CONFIG_FUNCTION_TRACER=y  
CONFIG_FUNCTION_GRAPH_TRACER=y 
CONFIG_DYNAMIC_FTRACE=y  
CONFIG_DYNAMIC_FTRACE_WITH_REGS=y  
# CONFIG_DYNAMIC_FTRACE_WITH_DIRECT_CALLS=y  
# CONFIG_DYNAMIC_FTRACE_WITH_ARGS=y  
CONFIG_SCHED_TRACER=y  
CONFIG_FTRACE_SYSCALLS=y  
CONFIG_TRACER_SNAPSHOT=y  
CONFIG_KPROBE_EVENTS=y  
CONFIG_UPROBE_EVENTS=y  
CONFIG_BPF_EVENTS=y  
CONFIG_DYNAMIC_EVENTS=y  
CONFIG_PROBE_EVENTS=y  
CONFIG_SYNTH_EVENTS=y  
CONFIG_HIST_TRIGGERS=y  
# TEST from Ubuntu config -> search_words = ['trac', 'trace', 'tracing', 'ftrace','kvm', 'guest' ]
```
